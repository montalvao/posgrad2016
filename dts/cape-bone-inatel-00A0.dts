/dts-v1/;
/plugin/;

/{
    compatible = "ti,beaglebone", "ti,beaglebone-black";
    part-number = "cape-bone-inatel";
	version = "00A0";

	fragment@0 {
		target = <&i2c2>;

		__overlay__ {
			#address-cells = <1>;
			#size-cells = <0>;
			pcf8574a: gpio@3f {
				compatible = "nxp,pcf8574a";
				reg = <0x3f>;
				gpio-controller;
				#gpio-cells = <2>;
			};
		};
	};
};

